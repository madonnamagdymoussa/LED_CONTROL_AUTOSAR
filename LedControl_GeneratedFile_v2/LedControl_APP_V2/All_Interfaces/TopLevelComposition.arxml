AUTOSAR XML (schema 00046)
package /TopLevelComposition_package
  composition sw component type TopLevelComposition
    component TopLevelComposition_Prototype_1: type=Application1_SWC_ButtonStateReading
    component TopLevelComposition_Prototype_2: type=Application2_SWC_LedSwitching
    component TopLevelComposition_Prototype_3: type=IOA_SWC_1
