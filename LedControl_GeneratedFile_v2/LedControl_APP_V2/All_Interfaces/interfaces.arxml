AUTOSAR XML (schema 00046)
package /Interfaces
  sender receiver interface SR_1_Button1State
    data SR_1_Button1State_Element_1: type=Value_1_ButtonState1
  sender receiver interface SR_2_Button2State
    data SR_2_Button2State_Element_1: type=Value_2_ButtonState2
  client server interface CS_1_ReadChannel
    operation CS_1_ReadChannel_Operation1
      arg CS_1_Operation_1_Argument_PortNum: type=Port_NumID, direction=INOUT
      arg CS_1_Operation_1_Argument_ChannelType: type=Dio_ChannelType, direction=INOUT
  client server interface CS_2_WriteChannel
    operation CS_2_WriteChannel_Operation_1
      arg CS_2_WriteChannel_Operation_1_Argument_1_PortNum: type=Port_NumID, direction=INOUT
      arg CS_2_WriteChannel_Operation_1_Argument_2_ChannelType: type=Dio_ChannelType, direction=INOUT
      arg CS_2_WriteChannel_Operation_1_Argument_3_LevelType: type=Dio_LevelType, direction=INOUT
