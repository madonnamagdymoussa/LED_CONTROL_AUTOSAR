AUTOSAR XML (schema 00046)
package /TopLevelComposition_package
  composition sw component type TopLevelComposition
    component TopLevelComposition_Prototype_1: type=Application1_SWC_ButtonStateReading
    component TopLevelComposition_Prototype_2: type=Application2_SWC_LedSwitching
    component TopLevelComposition_Prototype_3: type=IOA_SWC_1
    connect TopLevelComposition_Prototype_1.P_Port_1_SR1_Button1State -> TopLevelComposition_Prototype_2.R_Port_1_SR1_Button1State
    connect TopLevelComposition_Prototype_1.P_Port_2_SR2_Button2State -> TopLevelComposition_Prototype_2.R_Port_2_SR2_Button2State
    connect TopLevelComposition_Prototype_3.P_Port_1_CS_1_ReadChannel -> TopLevelComposition_Prototype_1.R_Port_CS_ReadChannel_App1
    connect TopLevelComposition_Prototype_3.P_Port_2_CS_2_WriteChannel -> TopLevelComposition_Prototype_2.R_Port_3_CS_2_LedState
