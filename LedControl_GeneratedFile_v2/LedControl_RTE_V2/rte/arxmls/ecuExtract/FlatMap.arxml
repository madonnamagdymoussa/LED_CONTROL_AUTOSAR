AUTOSAR XML (schema 00046)
package /FlatMap_package
  flat map FlatMap
