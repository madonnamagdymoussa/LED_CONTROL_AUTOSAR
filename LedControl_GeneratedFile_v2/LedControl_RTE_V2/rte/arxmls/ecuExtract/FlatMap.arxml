AUTOSAR XML (schema 00046)
package /FlatMap_package
  flat map FlatMap
    flat instance descriptor TopLevelComposition_Prototype_{1..3}: upstream-reference=RootSwCompositionPrototype_0.TopLevelComposition_Prototype_{1..3}, ecu-extract-reference=EcuInstance_0_FlatView.TopLevelComposition_Prototype_{1..3}
