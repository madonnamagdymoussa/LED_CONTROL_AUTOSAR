AUTOSAR XML (schema 4.0)
package /LedControl_PORT_DIO
  module config Dio
    ecuc param conf container DioConfig: destination=AUTOSAR/LedControl_PORT_DIO/Dio/DioConfig
      ecuc param conf container DioPort_0: destination=AUTOSAR/LedControl_PORT_DIO/Dio/DioConfig/DioPort/DioPort_0
        ecuc integer param value DioPortId: value=5
        6 x ecuc param conf container:
          DioChannel_0: destination=AUTOSAR/LedControl_PORT_DIO/Dio/DioConfig/DioPort/DioPort_0/DioChannel/DioChannel_0
            ecuc integer param value DioChannelId: value=0
          DioChannel_1: destination=AUTOSAR/LedControl_PORT_DIO/Dio/DioConfig/DioPort/DioPort_0/DioChannel/DioChannel_1
            ecuc integer param value DioChannelId: value=1
          DioChannel_2: destination=AUTOSAR/LedControl_PORT_DIO/Dio/DioConfig/DioPort/DioPort_0/DioChannel/DioChannel_2
            ecuc integer param value DioChannelId: value=2
          DioChannel_3: destination=AUTOSAR/LedControl_PORT_DIO/Dio/DioConfig/DioPort/DioPort_0/DioChannel/DioChannel_3
            ecuc integer param value DioChannelId: value=3
          DioChannel_4: destination=AUTOSAR/LedControl_PORT_DIO/Dio/DioConfig/DioPort/DioPort_0/DioChannel/DioChannel_4
            ecuc integer param value DioChannelId: value=4
          DioChannelGroup_0: destination=AUTOSAR/LedControl_PORT_DIO/Dio/DioConfig/DioPort/DioPort_0/DioChannelGroup/DioChannelGroup_0
            ecuc string param value DioChannelGroupIdentification: value=group1
            ecuc integer param value DioPortMask: value=0
            ecuc integer param value DioPortOffset: value=0
    ecuc param conf container DioGeneral: destination=AUTOSAR/LedControl_PORT_DIO/Dio/DioGeneral
      ecuc boolean param value DioDevErrorDetect: value=0
      ecuc boolean param value DioFlipChannelApi: value=1
      ecuc boolean param value DioVersionInfoApi: value=0
