AUTOSAR XML (schema 4.0)
package /LedControl_PORT_DIO
  module config Port
    ecuc param conf container PortConfigSet: destination=AUTOSAR/LedControl_PORT_DIO/Port/PortConfigSet
      ecuc param conf container PortContainer_0: destination=AUTOSAR/LedControl_PORT_DIO/Port/PortConfigSet/PortContainer/PortContainer_0
        ecuc integer param value PortNumberOfPortPins: value=5
        5 x ecuc param conf container:
          PortPin_0: destination=AUTOSAR/LedControl_PORT_DIO/Port/PortConfigSet/PortContainer/PortContainer_0/PortPin/PortPin_0
            ecuc enumeration param value PortPinDirection: value=PORT_PIN_IN
            ecuc boolean param value PortPinDirectionChangeable: value=0
            ecuc integer param value PortPinId: value=1
            ecuc enumeration param value PortPinInitialMode: value=PORT_PIN_MODE_DIO
            ecuc enumeration param value PortPinLevelValue
            ecuc enumeration param value PortPinMode: value=PORT_PIN_MODE_DIO
            ecuc boolean param value PortPinModeChangeable: value=0
            ecuc enumeration param value PortPinInputPullResistor: value=PORT_PIN_IN_PULL_UP
          PortPin_1: destination=AUTOSAR/LedControl_PORT_DIO/Port/PortConfigSet/PortContainer/PortContainer_0/PortPin/PortPin_1
            ecuc enumeration param value PortPinDirection: value=PORT_PIN_OUT
            ecuc boolean param value PortPinDirectionChangeable: value=0
            ecuc integer param value PortPinId: value=2
            ecuc enumeration param value PortPinInitialMode: value=PORT_PIN_MODE_DIO
            ecuc enumeration param value PortPinLevelValue: value=PORT_PIN_LEVEL_LOW
            ecuc enumeration param value PortPinMode: value=PORT_PIN_MODE_DIO
            ecuc boolean param value PortPinModeChangeable: value=0
            ecuc enumeration param value PortPinInputPullResistor
          PortPin_2: destination=AUTOSAR/LedControl_PORT_DIO/Port/PortConfigSet/PortContainer/PortContainer_0/PortPin/PortPin_2
            ecuc enumeration param value PortPinDirection: value=PORT_PIN_OUT
            ecuc boolean param value PortPinDirectionChangeable: value=0
            ecuc integer param value PortPinId: value=3
            ecuc enumeration param value PortPinInitialMode: value=PORT_PIN_MODE_DIO
            ecuc enumeration param value PortPinLevelValue: value=PORT_PIN_LEVEL_LOW
            ecuc enumeration param value PortPinMode: value=PORT_PIN_MODE_DIO
            ecuc boolean param value PortPinModeChangeable: value=0
            ecuc enumeration param value PortPinInputPullResistor
          PortPin_3: destination=AUTOSAR/LedControl_PORT_DIO/Port/PortConfigSet/PortContainer/PortContainer_0/PortPin/PortPin_3
            ecuc enumeration param value PortPinDirection: value=PORT_PIN_OUT
            ecuc boolean param value PortPinDirectionChangeable: value=0
            ecuc integer param value PortPinId: value=4
            ecuc enumeration param value PortPinInitialMode: value=PORT_PIN_MODE_DIO
            ecuc enumeration param value PortPinLevelValue: value=PORT_PIN_LEVEL_LOW
            ecuc enumeration param value PortPinMode: value=PORT_PIN_MODE_DIO
            ecuc boolean param value PortPinModeChangeable: value=0
            ecuc enumeration param value PortPinInputPullResistor
          PortPin_4: destination=AUTOSAR/LedControl_PORT_DIO/Port/PortConfigSet/PortContainer/PortContainer_0/PortPin/PortPin_4
            ecuc enumeration param value PortPinDirection: value=PORT_PIN_IN
            ecuc boolean param value PortPinDirectionChangeable: value=0
            ecuc integer param value PortPinId: value=5
            ecuc enumeration param value PortPinInitialMode: value=PORT_PIN_MODE_DIO
            ecuc enumeration param value PortPinLevelValue
            ecuc enumeration param value PortPinMode: value=PORT_PIN_MODE_DIO
            ecuc boolean param value PortPinModeChangeable: value=0
            ecuc enumeration param value PortPinInputPullResistor: value=PORT_PIN_IN_PULL_UP
    ecuc param conf container PortGeneral: destination=AUTOSAR/LedControl_PORT_DIO/Port/PortGeneral
      4 x ecuc boolean param value:
        PortDevErrorDetect: value=0
        PortSetPinDirectionApi: value=1
        PortSetPinModeApi: value=1
        PortVersionInfoApi: value=0
