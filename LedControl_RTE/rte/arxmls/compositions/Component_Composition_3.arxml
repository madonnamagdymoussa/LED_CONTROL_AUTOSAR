AUTOSAR XML (schema 00046)
package /Component_Composition_3_package
  composition sw component type Component_Composition_3
    component Component_Composition_3_Prototype_1: type=Component_Composition_1
    component Component_Composition_3_Prototype_2: type=Component_Composition_2
